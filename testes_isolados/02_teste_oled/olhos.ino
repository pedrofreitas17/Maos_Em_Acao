#include <Wire.h>
#include <Adafruit_GFX.h>
#include <Adafruit_SSD1306.h>
#include <FluxGarage_RoboEyes.h> 

#define SCREEN_WIDTH 128
#define SCREEN_HEIGHT 64
#define SCREEN_I2C_ADDR 0x3C 
#define OLED_RESET -1

Adafruit_SSD1306 display(SCREEN_WIDTH, SCREEN_HEIGHT, &Wire, OLED_RESET);
RoboEyes eyes(display); 

// --- CONTROLE DE ETAPAS ---
int etapaAtual = 1; 
unsigned long tempoInicio;    
unsigned long tempoDestaEtapa = 0; 
const int pinoBotao = 4; 
bool cicloAtivo = false;

// Controle da animação (para frames de 48x48)
int currentFrame = 0;
unsigned long lastFrameMillis = 0;
#define FRAME_DELAY 100

// =========================================================
// --- ARRAYS DE BITMAPS ESTÁTICOS (128x64 pixels) ---
// =========================================================

// 1. IMAGEM: PASSAR SABÃO
const unsigned char img_sabao [] PROGMEM = {
  0x00, 0x00, 0x00, 0x00, 0x00, 0x00, 0x00, 0x00, 0x00, 0x00, 0x0f, 0xfc, 0x00, 0x00, 0x00, 0x00, 
  0x00, 0x00, 0x00, 0x00, 0x00, 0x00, 0x00, 0x00, 0x00, 0x00, 0x7e, 0x07, 0x80, 0x00, 0x00, 0x00, 
  0x00, 0x00, 0x00, 0x00, 0x00, 0x00, 0x00, 0x00, 0x00, 0x00, 0xe0, 0x00, 0xc0, 0x00, 0x00, 0x00, 
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  0x00, 0x00, 0x00, 0x00, 0x00, 0x07, 0xfe, 0x00, 0x00, 0x00, 0x00, 0x00, 0x00, 0x00, 0x00, 0x00
};

// 2. IMAGEM: SECAR MÃOS
const unsigned char img_secar [] PROGMEM = {
  0x00, 0x00, 0x00, 0x00, 0x00, 0x00, 0x00, 0x00, 0x00, 0x00, 0x00, 0x00, 0x00, 0x00, 0x00, 0x00, 
  0x00, 0x00, 0x00, 0x00, 0x00, 0x00, 0x00, 0x00, 0x00, 0x00, 0x00, 0x00, 0x00, 0x00, 0x00, 0x00, 
  0x00, 0x00, 0x00, 0x00, 0x00, 0x00, 0x00, 0x00, 0x00, 0x00, 0x00, 0x00, 0x00, 0x00, 0x00, 0x00, 
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  0x00, 0x00, 0x00, 0x00, 0x00, 0x00, 0x00, 0x00, 0x00, 0x00, 0x00, 0x00, 0x00, 0x00, 0x00, 0x00
};

// =========================================================
// --- ARRAYS DE ANIMAÇÃO (48x48 pixels) ---
// =========================================================

// Animação de Esfregar
const unsigned char framesEsfregar[][288] PROGMEM = {
  {0,0,0,0,0,0,0,0,0,0,0,0,0,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0,0},
  {0,0,0,0,0,0,0,0,0,0,0,0,0,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0,0},
  {0,0,0,0,0,0,0,0,0,0,0,0,0,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0,0},
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  {0,0,0,0,0,0,0,0,0,0,0,0,0,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0,0}
};

// =========================================================

// --- FUNÇÃO PARA DESENHAR ANIMAÇÕES (48x48) ---
void animarBitmap(const unsigned char anim[][288], int total) {
  if (millis() - lastFrameMillis >= FRAME_DELAY) {
    lastFrameMillis = millis();
    currentFrame = (currentFrame + 1) % total;
  }
  // Desenha o frame atual no centro da tela e inverte as cores (linha preta no fundo branco que foi pintado antes)
  display.drawBitmap(40, 8, anim[currentFrame], 48, 48, BLACK);
}

void setup() {
  Serial.begin(115200);
  pinMode(pinoBotao, INPUT_PULLUP);
  
  if(!display.begin(SSD1306_SWITCHCAPVCC, SCREEN_I2C_ADDR)) {
    Serial.println(F("Falha na alocacao do OLED"));
    for(;;);
  }

  eyes.begin(SCREEN_WIDTH, SCREEN_HEIGHT, 100);
  eyes.setMood(HAPPY);
  eyes.setCuriosity(true);
  
  display.clearDisplay();
  tempoInicio = millis();
}

void loop() {
  unsigned long tempoAtual = millis();

  // Acionamento do botão para iniciar o ciclo
  if (digitalRead(pinoBotao) == LOW && !cicloAtivo) {
    delay(150); // Debounce
    cicloAtivo = true;
    etapaAtual = 1; 
    tempoInicio = tempoAtual;
    tempoDestaEtapa = 5000; 
    eyes.setMood(DEFAULT);
    
    Serial.println(">>> CICLO INICIADO <<<");
  }

  // Transição de etapas (Máquina de Estados)
  if (cicloAtivo) {
    if (tempoAtual - tempoInicio >= tempoDestaEtapa) {
      etapaAtual++;
      tempoInicio = tempoAtual;
      currentFrame = 0; // Reseta a animação

      Serial.print("Mudando para etapa: ");
      Serial.println(etapaAtual);

      if (etapaAtual > 6) { 
        cicloAtivo = false;
        etapaAtual = 0; 
        eyes.setMood(HAPPY);
        Serial.println(">>> CICLO FINALIZADO <<<");
      }
    }
  }

  display.clearDisplay();

  // Define o que desenhar baseado na etapa
  if (!cicloAtivo) {
    eyes.update(); // Modo de espera (Olhos piscando)
    eyes.setMood(HAPPY);
  } else {

    // Em TODAS as etapas do ciclo (exceto os olhos na etapa 6), o fundo será branco
    if (etapaAtual >= 1 && etapaAtual <= 5) {
        display.fillRect(0, 0, 128, 64, WHITE);
    }

    switch (etapaAtual) {
      case 1: // Molhar (Usa animação 48x48)
        animarBitmap(framesEsfregar, 2);
        tempoDestaEtapa = 5000;
        break;

      case 2: 
        display.drawBitmap(0, 0, img_sabao, 128, 64, BLACK);
        tempoDestaEtapa = 5000;
        break;

      case 3: 
        animarBitmap(framesEsfregar, 16);
        tempoDestaEtapa = 20000; 
        break;

      case 4: 
        animarBitmap(framesEsfregar, 2); 
        tempoDestaEtapa = 10000;
        break;

      case 5: 
        display.drawBitmap(0, 0, img_secar, 128, 64,BLACK);
        tempoDestaEtapa = 10000;
        break;

      case 6: 
        display.clearDisplay(); 
        eyes.setMood(HAPPY);
        eyes.update();
        tempoDestaEtapa = 5000;
        break;
    }
  }

  display.display();
}